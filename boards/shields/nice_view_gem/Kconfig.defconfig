## boards/shields/nice_view_gem/Kconfig.defconfig
```kconfig
if SHIELD_NICE_VIEW_GEM

config LV_Z_VDB_SIZE
    default 100

config LV_DPI_DEF
    default 161

config LV_Z_BITS_PER_PIXEL
    default 1

choice LV_COLOR_DEPTH
    default LV_COLOR_DEPTH_1
endchoice

choice ZMK_DISPLAY_WORK_QUEUE
    default ZMK_DISPLAY_WORK_QUEUE_DEDICATED
endchoice

choice ZMK_DISPLAY_STATUS_SCREEN
    default ZMK_DISPLAY_STATUS_SCREEN_CUSTOM
endchoice

config LV_Z_MEM_POOL_SIZE
    default 4096 if ZMK_DISPLAY_STATUS_SCREEN_CUSTOM

config ZMK_DISPLAY_STATUS_SCREEN_CUSTOM
    imply NICE_VIEW_WIDGET_STATUS

config NICE_VIEW_GEM_WPM_FIXED_RANGE
    bool "Enable fixed range for WPM gauge/chart"
    default y

config NICE_VIEW_GEM_WPM_FIXED_RANGE_MAX
    int "Fixed range maximum for WPM gauge/chart"
    default 100

config NICE_VIEW_GEM_ANIMATION
    bool "Enable animation on peripheral"
    default y

choice NICE_VIEW_GEM_ART
    prompt "Peripheral screen art style"
    default NICE_VIEW_GEM_ART_SLIDESHOW

config NICE_VIEW_GEM_ART_CRYSTAL
    bool "Rotating crystal animation"

config NICE_VIEW_GEM_ART_SLIDESHOW
    bool "Hammerbeam pixel art slideshow"

endchoice

config NICE_VIEW_GEM_ANIMATION_MS
    int "Animation length in milliseconds"
    default 960 if NICE_VIEW_GEM_ART_CRYSTAL
    default 1800000

config NICE_VIEW_WIDGET_STATUS
    select LV_USE_LABEL
    select LV_USE_IMG
    select LV_USE_CANVAS
    select LV_USE_ANIMIMG
    select LV_USE_ANIMATION

choice NICE_VIEW_GEM_WPM_STYLE
    prompt "WPM gauge style on central screen"
    default NICE_VIEW_GEM_WPM_NEEDLE

config NICE_VIEW_GEM_WPM_NEEDLE
    bool "Gauge with needle (original)"

config NICE_VIEW_GEM_WPM_BONGO_CAT
    bool "Bongo Cat (WPM-reactive)"

config NICE_VIEW_GEM_WPM_LUNA
    bool "Luna dog (WPM-reactive)"

endchoice

config NICE_VIEW_GEM_OUTPUT_BACKGROUND
    bool "Show background behind connection status icon"

config NICE_VIEW_WIDGET_INVERTED
    bool "Invert display colors"

if !ZMK_SPLIT || ZMK_SPLIT_ROLE_CENTRAL

config NICE_VIEW_WIDGET_STATUS
    select ZMK_WPM

endif # !ZMK_SPLIT || ZMK_SPLIT_ROLE_CENTRAL

endif # SHIELD_NICE_VIEW_GEM
```
